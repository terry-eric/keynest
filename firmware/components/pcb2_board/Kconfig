## firmware/components/pcb2_board/Kconfig
```kconfig
menu "PCB2 board"

choice PCB2_MICROPHONE
    prompt "Populated microphone (pin 2 tied to GND)"
    default PCB2_MIC_ZTS6672
    help
        Select the actual fitted part, rather than the schematic library name.
        ZTS6672 DS-13 specifies the right I2S slot with SELECT low and CONFIG
        open. ICS-43434 uses the left slot with LR low. This setting does not
        change the shared speaker I2S clocks or format.

config PCB2_MIC_ZTS6672
    bool "ZillTek ZTS6672"

config PCB2_MIC_ICS43434
    bool "TDK ICS-43434 (LR low; left slot)"

endchoice

config PCB2_MIC_RIGHT_SLOT
    bool "Read right microphone slot at startup"
    default n
    help
        The tested PCB currently provides nonzero data only in the left slot.
        ZTS6672 DS-13 specifies right with SELECT low and CONFIG open, so its
        actual mode/pin state still needs checking. Override this for a board
        confirmed to drive right. The keypad diagnostic selector can switch
        slots temporarily without changing clocks or reflashing.

endmenu
```

## firmware/keyboard/main/Kconfig.projbuild
```kconfig
menu "PCB2 Keypad"
    config PCB2_AP_PREFIX
        string "Wi-Fi AP name prefix (up to 26 ASCII characters)"
        default "PCB2-Keypad"
    config PCB2_AP_PASSWORD
        string "Wi-Fi WPA2 password (8 to 63 characters)"
        default "pcb2play"
    config PCB2_RECORD_SECONDS
        int "Maximum duration of one WAV recording"
        range 10 600
        default 600
endmenu
```

## firmware/keyboard/sdkconfig.defaults
```kconfig
CONFIG_IDF_TARGET="esp32s3"
CONFIG_PCB2_RECORD_SECONDS=600
CONFIG_PCB2_MIC_ZTS6672=y
# CONFIG_PCB2_MIC_RIGHT_SLOT is not set
CONFIG_ESPTOOLPY_FLASHSIZE_4MB=y
CONFIG_SPIRAM=y
CONFIG_SPIRAM_MODE_QUAD=y
CONFIG_SPIRAM_TYPE_AUTO=y
CONFIG_SPIRAM_SPEED_40M=y
CONFIG_SPIRAM_BOOT_INIT=y
CONFIG_SPIRAM_USE_CAPS_ALLOC=y
CONFIG_SPIRAM_IGNORE_NOTFOUND=y
CONFIG_SPIRAM_MEMTEST=y
CONFIG_PARTITION_TABLE_CUSTOM=y
CONFIG_PARTITION_TABLE_CUSTOM_FILENAME="partitions.csv"
CONFIG_ESP_CONSOLE_NONE=y
CONFIG_ESP_CONSOLE_SECONDARY_NONE=y
CONFIG_FREERTOS_HZ=1000
CONFIG_TINYUSB_HID_COUNT=1
CONFIG_TINYUSB_CDC_ENABLED=y
CONFIG_TINYUSB_CDC_COUNT=1
CONFIG_TINYUSB_CDC_RX_BUFSIZE=2048
CONFIG_TINYUSB_CDC_TX_BUFSIZE=8192
CONFIG_LWIP_MAX_SOCKETS=10
CONFIG_HTTPD_MAX_REQ_HDR_LEN=1024
CONFIG_HTTPD_MAX_URI_LEN=128
```
